#include "contour.dtsi"

&default_transform { // The matrix transform for this board is 6 columns over because the left half is 6 columns wide according to the matrix.
    col-offset = <6>;
};

&kscan0 {
    col-gpios
        = <&pro_micro 1 GPIO_ACTIVE_HIGH> //col7 in schematic
         ,<&pro_micro 0 GPIO_ACTIVE_HIGH> //col8
         ,<&pro_micro 2 GPIO_ACTIVE_HIGH> //col9
         ,<&pro_micro 3 GPIO_ACTIVE_HIGH> //col10
         ,<&pro_micro 4 GPIO_ACTIVE_HIGH> //col11
         ,<&pro_micro 5 GPIO_ACTIVE_HIGH> //col12
         ;
};
