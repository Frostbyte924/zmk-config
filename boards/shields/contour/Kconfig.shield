## boards/shields/contour/Kconfig.shield
```kconfig
config SHIELD_CONTOUR_LEFT
    def_bool $(shields_list_contains,contour_left)

config SHIELD_CONTOUR_RIGHT
    def_bool $(shields_list_contains,contour_right)
```

## config/Kconfig.defconfig
```kconfig
if SHIELD_CONTOUR_LEFT

config ZMK_KEYBOARD_NAME
    default "Contour KB"

config ZMK_SPLIT_ROLE_CENTRAL
    default y

endif

if SHIELD_CONTOUR_LEFT || SHIELD_CONTOUR_RIGHT

config ZMK_SPLIT
    default y

endif
```

## config/west.yml
```yaml
manifest:
  remotes:
    - name: zmkfirmware
      url-base: https://github.com/zmkfirmware
    # Additional modules containing boards/shields/custom code can be listed here as well
    # See https://docs.zephyrproject.org/3.2.0/develop/west/manifest.html#projects
    - name: Frostbyte924
      url-base: https://github.com/Frostbyte924
  projects:
    - name: zmk
      remote: zmkfirmware
      revision: main
      import: app/west.yml
    - name: zmk-config
      remote: Frostbyte924
      revision: main
      import: boards/shields/contour/
  self:
    path: config
```
